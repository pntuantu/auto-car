## sdkconfig.defaults
```kconfig
# ESP-IDF SDK Configuration Defaults for Auto-Car Firmware

# Board Configuration
CONFIG_IDF_TARGET="esp32"

# Partition Table
CONFIG_PARTITION_TABLE_OFFSET=0x8000

# UART Configuration
CONFIG_ESP_CONSOLE_UART_NUM=0
CONFIG_ESP_CONSOLE_UART_BAUDRATE=115200

# I2C Configuration  
CONFIG_I2C_MASTER=y

# GPIO Configuration
CONFIG_GPIO_CTRL_FUNC_IN_IRAM=y

# Performance Optimization
CONFIG_ESP_DEFAULT_CPU_FREQ_MHZ=240
```
